## config/west.yml
```yaml
manifest:
  remotes:
    - name: zmkfirmware
      url-base: https://github.com/zmkfirmware
    - name: sayu-hub
      url-base: https://github.com/sayu-hub
    - name: caksoylar
      url-base: https://github.com/caksoylar
    - name: kot149
      url-base: https://github.com/kot149

  projects:
    - name: zmk
      remote: zmkfirmware
      revision: main
      import: app/west.yml

    # トラックボール（PMW3610）
    - name: zmk-pmw3610-driver
      remote: sayu-hub
      revision: main

    # RGB LED ウィジェット（shield: rgbled_adapter 用）
    - name: zmk-rgbled-widget
      remote: caksoylar
      revision: main

    # Layout Shift（JIS/US ずれを実行時に吸収）
    - name: zmk-layout-shift
      remote: kot149
      revision: v1

  self:
    path: config
```
